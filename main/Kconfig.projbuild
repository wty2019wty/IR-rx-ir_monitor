## main/Kconfig.projbuild
```kconfig
menu "IR Monitor Configuration"

    config IR_MONITOR_IR_RX_GPIO
        int "IR receiver GPIO (VS1838B OUT)"
        default 4

    config IR_MONITOR_IR_TX_GPIO
        int "IR transmitter GPIO (with carrier modulator)"
        default 5

    config IR_MONITOR_OLED_SDA_GPIO
        int "OLED I2C SDA GPIO"
        default 8

    config IR_MONITOR_OLED_SCL_GPIO
        int "OLED I2C SCL GPIO"
        default 9

    config IR_MONITOR_OLED_I2C_ADDR
        hex "OLED I2C device address (7-bit, without R/W bit)"
        default 0x3C

    config IR_MONITOR_OLED_I2C_CLK_HZ
        int "OLED I2C clock frequency (Hz)"
        default 400000

    config IR_MONITOR_BTN_UP_GPIO
        int "Button UP GPIO"
        default 39

    config IR_MONITOR_BTN_DOWN_GPIO
        int "Button DOWN GPIO"
        default 38

    config IR_MONITOR_BTN_OK_GPIO
        int "Button OK GPIO"
        default 1

    config IR_MONITOR_BTN_BACK_GPIO
        int "Button BACK GPIO"
        default 2

    config IR_MONITOR_CARRIER_FREQ_HZ
        int "IR carrier frequency (Hz)"
        default 38000
        help
            Carrier frequency for IR transmission. Common values:
            - 38000 (38kHz) for most consumer electronics
            - 36000 for some older protocols
            - 40000 for some specific devices

    config IR_MONITOR_CARRIER_DUTY
        int "IR carrier duty cycle (percent)"
        default 33
        help
            Duty cycle of the carrier signal in percent.
            Typical values: 25-50% (33% is common for 38kHz)

endmenu
```
